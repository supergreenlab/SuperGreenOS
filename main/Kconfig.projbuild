## main/Kconfig.projbuild
```kconfig
menu "SuperGreenOS Configuration"

config VERSION
  string "A name to give to this version"
  default "PicklePreRelease"
  help
    Version displayed in the logs

endmenu
```

## main/Kconfig.projbuild.template
```kconfig
menu "SuperGreenOS Configuration"

config VERSION
  string "A name to give to this version"
  default "<%= name %>"
  help
    Version displayed in the logs

endmenu
```

## sdkconfig.defaults
```kconfig
CONFIG_BROKER_URL="mqtt://broker.supergreenlab.com:1883"
CONFIG_LOG_DEFAULT_LEVEL_NONE=
CONFIG_LOG_DEFAULT_LEVEL_ERROR=
CONFIG_LOG_DEFAULT_LEVEL_WARN=
CONFIG_LOG_DEFAULT_LEVEL_INFO=y
CONFIG_LOG_DEFAULT_LEVEL_DEBUG=
CONFIG_LOG_DEFAULT_LEVEL_VERBOSE=
```
